VERSION ""

NS_ :

BS_:

BU_: Vehicle_ECU

BO_ 256 VehicleSpeed: 2 Vehicle_ECU
SG_ Vehicle_Speed : 0|16@1+ (0.1,0) [0|120] "km/h" Vehicle_ECU

BO_ 257 EngineRPM: 2 Vehicle_ECU
SG_ Engine_RPM : 0|16@1+ (1,0) [800|5000] "rpm" Vehicle_ECU

BO_ 258 CoolantTemperature: 2 Vehicle_ECU
SG_ Coolant_Temperature : 0|16@1+ (0.1,-40) [20|120] "degC" Vehicle_ECU

BO_ 259 FuelLevel: 2 Vehicle_ECU
SG_ Fuel_Level : 0|16@1+ (0.1,0) [0|100] "%" Vehicle_ECU

BO_ 260 BatteryVoltage: 2 Vehicle_ECU
SG_ Battery_Voltage : 0|16@1+ (0.01,0) [11|15] "V" Vehicle_ECU

BO_ 261 AmbientTemperature: 2 Vehicle_ECU
SG_ Ambient_Temperature : 0|16@1- (0.1,-40) [-40|80] "degC" Vehicle_ECU
